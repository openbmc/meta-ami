## meta-olympus/conf/machine/olympus.conf
```bitbake
KMACHINE = "aspeed"
KERNEL_DEVICETREE = "${KMACHINE}-bmc-opp-olympus.dtb"

require conf/machine/include/ast2400.inc
require conf/machine/include/obmc-bsp-common.inc

UBOOT_MACHINE_olympus = "ast_g4_phy_config"
UBOOT_ENTRYPOINT = "0x40008000"
UBOOT_LOADADDRESS = "0x40008000"

FLASH_SIZE = "32768"

VIRTUAL-RUNTIME_skeleton_workbook = "${MACHINE}-config"
```

## meta-wolfpass/conf/layer.conf
```bitbake
# We have a conf and classes directory, add to BBPATH
BBPATH .= ":${LAYERDIR}"

# We have recipes-* directories, add to BBFILES
BBFILES += "${LAYERDIR}/recipes-*/*/*.bb \
	${LAYERDIR}/recipes-*/*/*.bbappend"

BBFILE_COLLECTIONS += "wolfpass"
BBFILE_PATTERN_wolfpass = "^${LAYERDIR}/"
BBFILE_PRIORITY_wolfpass = "6"
PREFERRED_VERSION_ipmitool = "ami"
```

## meta-wolfpass/conf/machine/wolfpass.conf
```bitbake
KMACHINE = "aspeed"
KERNEL_DEVICETREE = "${KMACHINE}-bmc-opp-wolfpass.dtb"

require conf/machine/include/ast2500.inc
require conf/machine/include/obmc-bsp-common.inc

UBOOT_MACHINE_wolfpass = "ast_g5_phy_config"
UBOOT_ENTRYPOINT = "0x80008000"
UBOOT_LOADADDRESS = "0x80008000"

FLASH_SIZE = "32768"
```
